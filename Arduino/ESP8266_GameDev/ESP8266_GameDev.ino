#include <SPI.h>
#include <Wire.h>
#include <Adafruit_GFX.h>
#include <Adafruit_SSD1306.h>

#define SC_W 128
#define SC_H 64 

#define OLED_RESET     -1 // Reset pin # (or -1 if sharing Arduino reset pin)
#define SCREEN_ADDRESS 0x3C ///< See datasheet for Address; 0x3D for 128x64, 0x3C for 128x32
Adafruit_SSD1306 display(SC_W, SC_H, &Wire, OLED_RESET);

int gridSize = 8;

int buttons[4] = {2,5,4,0}; // U,L,D,R; D0,D1,D2,D3
int butStates[4];
#define BAT_RESET 15
unsigned long timeSinceRST;

#define SNAKE_MAX_LEN 64
int snake_x[SNAKE_MAX_LEN];
int snake_y[SNAKE_MAX_LEN];
int snake_len = 2;
int score = 0;
int snake_dir = 0; // 0=R,1=U,2=L,3=D
int food_x;
int food_y;


static const unsigned char snake [] PROGMEM = {
	// 'snake, 128x64px
	0xbd, 0xef, 0x7b, 0xde, 0xf7, 0xbd, 0xef, 0x7b, 0xde, 0xf7, 0xbd, 0xef, 0x7b, 0xde, 0xf7, 0xbd, 
	0xbd, 0xef, 0x7b, 0xde, 0xf7, 0xbd, 0xef, 0x7b, 0xde, 0xf7, 0xbd, 0xef, 0x7b, 0xde, 0xf7, 0xbd, 
	0x00, 0x00, 0x00, 0x00, 0x00, 0x00, 0x00, 0x00, 0x00, 0x00, 0x00, 0x00, 0x00, 0x00, 0x00, 0x00, 
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	0xf7, 0xbd, 0xef, 0x7b, 0xde, 0xf7, 0xbd, 0xef, 0x7b, 0xde, 0xf7, 0xbd, 0xef, 0x7b, 0xde, 0xf7
};


void setup() {
  // put your setup code here, to run once:
  Wire.begin(14,12);
  if(!display.begin(SSD1306_SWITCHCAPVCC, SCREEN_ADDRESS)) {
      Serial.println(F("SSD1306 allocation failed"));
      for(;;); // Don't proceed, loop forever
    }  
    drawSplashScreen();
  display.clearDisplay();
  pinMode(BAT_RESET,OUTPUT);
  digitalWrite(BAT_RESET,1);
  for(int i=0;i<4;i++){
    pinMode(buttons[i],INPUT_PULLUP);
  }
  food_x = random(0,SC_W/gridSize);
  food_y = random(0,SC_H/gridSize);
  snake_x[0] = 0;
  snake_y[0] = 0;
  snake_x[1] = 1;
  snake_y[1] = 0;
  drawSnake();
  drawFood();
  drawGrid();
  display.display();
}

void loop() {
  // put your main code here, to run repeatedly:
  timeSinceRST = millis();
  if(timeSinceRST == 20000){
    digitalWrite(BAT_RESET, 0);
    timeSinceRST = 0;
  }
  delay(100);
  for(int j=0; j<=3; j++){
  butStates[j] = digitalRead(buttons[j]);
  }
    
  if((butStates[3] == 0) && (snake_dir != 2)){
    snake_dir = 0;
  }else if((butStates[1] == 0) && (snake_dir != 0)){
    snake_dir = 2;
  }else if((butStates[2] == 0) && (snake_dir != 1)){
    snake_dir = 3;
  }else if((butStates[0] == 0) && (snake_dir != 3)){
    snake_dir = 1;
  }
  for(int i = snake_len-1; i > 0; i--){
    snake_x[i] = snake_x[i-1];
    snake_y[i] = snake_y[i-1];
  }
  switch(snake_dir){
    case 0:
      snake_x[0]++;
      break;
    case 1:
      snake_y[0]--;
      break;
    case 2:
      snake_x[0]--;
      break;
    case 3:
      snake_y[0]++;
      break;
  }

  if(snake_x[0] < 0){
    snake_x[0] = SC_W/gridSize-1;
  }else if(snake_x[0] >= SC_W/gridSize){
    snake_x[0] = 0;
  }

  if(snake_y[0] < 0){
    snake_y[0] = SC_H/gridSize-1;
  }else if(snake_y[0] >= SC_H/gridSize){
    snake_y[0] = 0;
  }

  // eat apple
  if(snake_x[0] == food_x && snake_y[0] == food_y){ // check for collision w/ food object
    if(snake_len < SNAKE_MAX_LEN){
      snake_len++;
    }
    score += 10;
    food_x = random(0, SC_W/gridSize);
    food_y = random(0,SC_H/gridSize);
  }
  for(int k=1; k < snake_len; k++){ // Check for snake collision
    if(snake_x[0] == snake_x[k] && snake_y[0] == snake_y[k]){
      gameOver();
      Reset();
    }
  }
  display.clearDisplay();
  drawSnake();
  drawFood();
  drawGrid();
  display.display();
}

void drawSplashScreen(){
  display.clearDisplay();
  display.drawBitmap(0,0,snake,128,64,SSD1306_WHITE);
  display.display();
  delay(3000);
}

void drawSnake(){
  for(int i=0;i<snake_len;i++){
    display.fillRect(snake_x[i]*gridSize, snake_y[i]*gridSize, gridSize, gridSize, SSD1306_WHITE);
  }
}
void drawFood(){
  display.fillRect(food_x*gridSize, food_y*gridSize, gridSize, gridSize, SSD1306_WHITE);
}
void gameOver(){
  int y;
  for(float i = 0; i<4*3.14159; i+=0.3){
    y = int(sin(i)*14);
    display.clearDisplay();
    display.setTextSize(2);
    display.setTextColor(SSD1306_WHITE);
    display.setCursor(5,y);
    display.println("Game Over!");
    display.setTextSize(1);
    display.setCursor(5,y+20);
    display.print("Score: ");
    display.println(score);
    display.display();
    delay(125);
  }
}
void Reset(){
  score = 0;
  food_x = random(0, SC_W/gridSize);
  food_y = random(0, SC_H/gridSize);
  snake_len = 2;
  snake_dir = 0;
  snake_x[0] = 0;
  snake_y[0] = 0;
  snake_x[1] = 1;
  snake_y[1] = 0;
}

void drawGrid(){
  for(int x=0; x<SC_W; x+=gridSize){
    for(int y=0; y < SC_H; y += gridSize){
      display.drawRect(x, y, gridSize, gridSize, SSD1306_BLACK);
    }
  }
  display.display();
}
